#include <Wire.h>

bool dir = 1;
byte ledNum, second, minute, hour, day, weekday, month, year;
int strLength, col, row;
String DayofWeek[] = {"Sunday", "Monday", "Tuesday", "Wednesday", "Thursday", "Friday", "Saturday"};
unsigned long time[4] = {0, 0, 0, 0};
void PCF8563_setup();
void PCF8563_Read();
char time_now[] = "00:00:00";
float period = 60000000.0, second_lit, minute_lit, hour_lit, minute_adjust, hour_adjust;

const byte font[][5] = { // char hex ascii number 
  {0x00,0x00,0x00,0x00,0x00}, // 0x20 32 0
  {0x00,0x00,0x6f,0x00,0x00}, // ! 0x21 33 1
  {0x00,0x07,0x00,0x07,0x00}, // " 0x22 34 2
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  {0x04,0x02,0x04,0x08,0x04}, // ~ 0x7e 126 94
};

void setup() {
  // put your setup code here, to run once:
  Serial.begin(9600);
  Wire.begin();
  for(int i = 2; i < 13; i++){
    pinMode(i, OUTPUT);
  }
  second = 20;
  minute = 3;
  hour = 9;
  weekday = 6;
  day = 24;
  month = 6;
  year = 17;
  // comment out the next line and upload again to set and keep the time from resetting every reset
  PCF8563_setup();
  //PCF8365_setup(01, 40, 18, 28, 5, 7, 17); //sec, min, hr, day, weekday, month, yr
}

void loop() {
  // put your main code here, to run repeatedly:
  /*if(dir == 1){
    for(ledNum = 2; ledNum < 13; ledNum++){
      //delay(100);
      digitalWrite(ledNum, HIGH);
      if(ledNum != 2) digitalWrite(ledNum - 1, LOW);
      if(ledNum != 12) delay(50);
      if(ledNum == 12){
        digitalWrite(ledNum, LOW);
        dir = 0;
      }
    }
  }

  if(dir == 0){
    for(ledNum = 12; ledNum > 1; ledNum--){
      //delay(100);
      digitalWrite(ledNum, HIGH);
      if(ledNum != 12) digitalWrite(ledNum + 1, LOW);
      if(ledNum != 2) delay(50);
      if(ledNum == 2){
        digitalWrite(ledNum, LOW);
        dir = 1;
      }
    }
  }*/

  /*for(col = 0; col < 5; col++){
    for(row = 0; row < 8; row++){
      digitalWrite(row + 3, bitRead(H[col], row));
      //delay(50);
    }
  }

  for(int i = 2; i < 13; i++){
    digitalWrite(i, LOW);
  }
  delay(15);

  for(col = 0; col < 5; col++){
    for(row = 0; row < 8; row++){
      digitalWrite(row + 3, bitRead(E[col], row));
      //delay(50);
    }
  }

  for(int i = 2; i < 13; i++){
    digitalWrite(i, LOW);
  }
  delay(15);*/
  //Display("Saturday");
  analog_clock();
  if(millis() - time[2] >= 1000){
    //PCF8563_Read();
    /*time_now[1] = (int)hour;
    time_now[4] = (int)minute;
    time_now[7] = (char)second*/;
    second_lit = ((float)second/60.00) * (float)period;
    /*minute_adjust = second_lit/60.000;
    Serial.print(minute_adjust);*/
    minute_lit = ((float)minute/60.0) * (float)period + second_lit/60.0;
    hour_lit = ((float)hour/12.0) * (float)period + + minute_lit/60.0;
    /*Serial.print(second_lit);
    Serial.print("  ");
    Serial.print(minute_lit);
    Serial.print("  ");
    Serial.print(hour_lit);
    Serial.print("  ");*/
    serial_print();
    time[2] = millis();
  }
}

void Display(char POVString[]){
  if(millis() - time[1] >= 200){
    strLength = strlen(POVString);
    for(int i = 0; i < strLength; i++){
      if(millis() - time[0] >= 10){
        for(col = 0; col < 5; col++){
          for(row = 0; row < 8; row++){
              digitalWrite(row + 3, bitRead(font[POVString[i] - 32][col], row));
              delay(1);
          }
          for(int a = 2; a < 13; a++){
              digitalWrite(i, LOW);
            }
        }
        time[0] = millis();
      }
    }
    time[1] = millis();
  }
}

void analog_clock() {
  if(micros() - time[3] >= period){
    time[3] = micros();
  }

  //Displaying the marks
  if(micros() - time[3] >= (14.75*period/60) && micros() - time[3] <= (15.25*period/60.0)){
    digitalWrite(3, HIGH);
  }else if(micros() - time[3] >= (29.75*period/60) && micros() - time[3] <= (30.25*period/60.0)){
    digitalWrite(3, HIGH);
  }else if(micros() - time[3] >= (44.75*period/60) && micros() - time[3] <= (45.25*period/60.0)){
    digitalWrite(3, HIGH);
  }else if(micros() - time[3] >= (59.75*period/60) || micros() - time[3] <= (1*period/240)){
    digitalWrite(3, HIGH);
  }else{
    digitalWrite(3, LOW);
  }
  
  //Making the seconds display
  if(micros() - time[3] <= second_lit){
    digitalWrite(2, HIGH);
  }else{
    digitalWrite(2, LOW);
  }

  //Making the minute display
  if(micros() - time[3] <= minute_lit){
    for(int i = 4; i < 8; i++){
      digitalWrite(i, HIGH);
    }
  }else{
    for(int i = 4; i < 8; i++){
      digitalWrite(i, LOW);
    }
  }

  //Making the hour display
  if(micros() - time[3] <= hour_lit){
    for(int i = 8; i < 13; i++){
      digitalWrite(i, HIGH);
    }
  }else{
    for(int i = 8; i < 13; i++){
      digitalWrite(i, LOW);
    }
  }
}
byte bcdToDec(byte value){
  return ((value / 16) * 10 + value % 16);
}

byte decToBcd(byte value){
  return ((value / 10) * 16 + value % 10);
}

void PCF8563_setup(){
  Wire.beginTransmission(0x51);
  Wire.write(0x02);
  Wire.write(decToBcd(second));
  Wire.write(decToBcd(minute));
  Wire.write(decToBcd(hour));
  Wire.write(decToBcd(day));
  Wire.write(decToBcd(weekday));
  Wire.write(decToBcd(month));
  Wire.write(decToBcd(year));
  Wire.endTransmission();
}

void PCF8563_Read(){
  Wire.beginTransmission(0x51);
  Wire.write(0x02);
  Wire.endTransmission();
  Wire.requestFrom(0x51, 7);
  second = bcdToDec(Wire.read() & B01111111);
  minute = bcdToDec(Wire.read() & B01111111);
  hour = bcdToDec(Wire.read() & B00111111);
  day = bcdToDec(Wire.read() & B00111111);
  weekday = bcdToDec(Wire.read() & B00000111);
  month = bcdToDec(Wire.read() & B0001111);
  year = bcdToDec(Wire.read() & B11111111);
}

void serial_print(){
  Serial.print(month, DEC);
  Serial.print(F("/"));
  Serial.print(day, DEC);
  Serial.print(F("/"));
  Serial.print(year, DEC);
  Serial.print(F("\t\t"));
  Serial.print(DayofWeek[weekday]);
  Serial.print(F("\t\t"));
  if(hour < 10) Serial.print(F("0"));
  Serial.print(hour, DEC);
  Serial.print(F(":"));
  if(minute < 10) Serial.print(F("0"));
  Serial.print(minute, DEC);
  Serial.print(F(":"));
  if(second < 10) Serial.print(F("0"));
  Serial.println(second, DEC);
}

